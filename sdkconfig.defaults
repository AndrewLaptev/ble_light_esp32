## sdkconfig.defaults
```kconfig
CONFIG_BT_ENABLED=y
CONFIG_BTDM_CTRL_MODE_BLE_ONLY=y
CONFIG_BTDM_CTRL_MODE_BR_EDR_ONLY=n
CONFIG_BTDM_CTRL_MODE_BTDM=n
CONFIG_CTRL_BTDM_MODEM_SLEEP=n
CONFIG_BTDM_SCAN_DUPL_TYPE_DATA_DEVICE=y
CONFIG_BTDM_BLE_MESH_SCAN_DUPL_EN=y
CONFIG_BT_GATTS_SEND_SERVICE_CHANGE_MANUAL=y
CONFIG_BT_BTU_TASK_STACK_SIZE=4512
CONFIG_BT_ACL_CONNECTIONS=5
CONFIG_BT_MULTI_CONNECTION_ENBALE=y
```

## src/Kconfig.projbuild
```kconfig
menu "BLightESP32 Configuration"

    config DEVICE_NAME
        string "Device name"
        default "ESP_LIGHT_NODE"
        help
            Bluetooth name for device

    config ACCESS_TOKEN
        int "Access token"
        default 12345
        help
            Access token authorization for light manage

    config DB_MAX_CONNECTIONS
        int "Max DB connections size"
        default 5
        help
            Max connections to light manage (max DB connections size)

    config LEDC_COLOR_TEMP_MIN
        int "MIN color temperature"
        default 2700
        help
            Minimum color temperature for LED

    config LEDC_COLOR_TEMP_MAX
        int "MAX color temperature"
        default 6500
        help
            Maximum color temperature for LED

endmenu
```
